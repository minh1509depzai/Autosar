AUTOSAR XML (schema 4-0-3)
package /ConfigurationParameters_Extract
  elements:
    labels=l-4=DoIPDevelopmentErrorDetect, annotation-text=[Source: AUTOSAR_SWS_DiagnosticOverIP.pdf, ECUCItemID: ECUC_DoIP_00004, ParentContainer: DoIPGeneral, Type: EcucBooleanParamDef, RangeOrReferenceTarget: Not specified in source, Multiplicity: 1, DefaultValue: Post-Build Variant false, PostBuildVariant: false, Description: Switches the development error detection and notification on or off. • true: detection and notification is enabled. • false: detection and notification is disabled., Relationship: Not specified in source, EvidenceClassification: Explicit, SourceReference: 10.2.3 DoIPGeneral; PDF page 87 (printed page 87)]
    labels=l-4=DoIPDhcpOptionVinUse, annotation-text=[Source: AUTOSAR_SWS_DiagnosticOverIP.pdf, ECUCItemID: ECUC_DoIP_00067, ParentContainer: DoIPGeneral, Type: EcucBooleanParamDef, RangeOrReferenceTarget: Not specified in source, Multiplicity: 1, DefaultValue: Post-Build Variant false, PostBuildVariant: false, Description: If DoIPDhcpOptionVinUse is set to true the DoIP module will add the VIN to the Dhcp host name if no valid Dhcp host name is already set., Relationship: Not specified in source, EvidenceClassification: Explicit, SourceReference: 10.2.3 DoIPGeneral; PDF page 87 (printed page 87)]
    labels=l-4=DoIPEntityStatusMaxByteFieldUse, annotation-text=[Source: AUTOSAR_SWS_DiagnosticOverIP.pdf, ECUCItemID: ECUC_DoIP_00064, ParentContainer: DoIPGeneral, Type: EcucBooleanParamDef, RangeOrReferenceTarget: Not specified in source, Multiplicity: 1, DefaultValue: Post-Build Variant false, PostBuildVariant: false, Description: This parameter is used to distinguish the optional support of the Max data size element of a diagnostic entity status response., Relationship: Not specified in source, EvidenceClassification: Explicit, SourceReference: 10.2.3 DoIPGeneral; PDF page 87 (printed page 87)]
    labels=l-4=DoIPGIDInvalidityPattern, annotation-text=[Source: AUTOSAR_SWS_DiagnosticOverIP.pdf, ECUCItemID: ECUC_DoIP_00065, ParentContainer: DoIPGeneral, Type: EcucIntegerParamDef, RangeOrReferenceTarget: 0 .. 255, Multiplicity: 1, DefaultValue: Post-Build Variant false, PostBuildVariant: false, Description: Specifies the Byte pattern that is used for response messages if no valid GID could be retrieved. Only the value ’0’ or ’255’ is allowed"., Relationship: Not specified in source, EvidenceClassification: Explicit, SourceReference: 10.2.3 DoIPGeneral; PDF page 88 (printed page 88)]
    labels=l-4=DoIPHostNameSizeMax, annotation-text=[Source: AUTOSAR_SWS_DiagnosticOverIP.pdf, ECUCItemID: ECUC_DoIP_00073, ParentContainer: DoIPGeneral, Type: EcucIntegerParamDef, RangeOrReferenceTarget: 5 .. 255, Multiplicity: 1, DefaultValue: Post-Build Variant false, PostBuildVariant: false, Description: Maximum Size of the DHCP HostName in ASCII. This parameter is necessary to reserve the correct amount of bytes for working with the DHCP HostName option. Minimum range is 5 because Dhcp Host Name should be at least "DoIP-" on any configuration., Relationship: Not specified in source, EvidenceClassification: Explicit, SourceReference: 10.2.3 DoIPGeneral; PDF page 88 (printed page 88)]
    labels=l-4=DoIPMainFunctionPeriod, annotation-text=[Source: AUTOSAR_SWS_DiagnosticOverIP.pdf, ECUCItemID: ECUC_DoIP_00006, ParentContainer: DoIPGeneral, Type: EcucFloatParamDef, RangeOrReferenceTarget: ]0 .. INF[, Multiplicity: 1, DefaultValue: Post-Build Variant false, PostBuildVariant: false, Description: Determines the frequency at which the DoIP_MainFunction() is called in [s]., Relationship: Not specified in source, EvidenceClassification: Explicit, SourceReference: 10.2.3 DoIPGeneral; PDF page 88 (printed page 88)]
    labels=l-4=DoIPMaxRequestBytes, annotation-text=[Source: AUTOSAR_SWS_DiagnosticOverIP.pdf, ECUCItemID: ECUC_DoIP_00019, ParentContainer: DoIPGeneral, Type: EcucIntegerParamDef, RangeOrReferenceTarget: 1 .. 4294967295, Multiplicity: 1, DefaultValue: Post-Build Variant false, PostBuildVariant: false, Description: Specifies the maximum allowed bytes of a DoIP message request without the DoIP header., Relationship: Not specified in source, EvidenceClassification: Explicit, SourceReference: 10.2.3 DoIPGeneral; PDF page 89 (printed page 89)]
    labels=l-4=DoIPMaxUDPRequestPerConnection, annotation-text=[Source: AUTOSAR_SWS_DiagnosticOverIP.pdf, ECUCItemID: ECUC_DoIP_00074, ParentContainer: DoIPGeneral, Type: EcucIntegerParamDef, RangeOrReferenceTarget: 1 .. 255, Multiplicity: 1, DefaultValue: Post-Build Variant false, PostBuildVariant: false, Description: This parameter captures the maximum amount of UDP Requests necessary to handle parallel within a single UDP connection., Relationship: Not specified in source, EvidenceClassification: Explicit, SourceReference: 10.2.3 DoIPGeneral; PDF page 89 (printed page 89)]
    labels=l-4=DoIPNodeType, annotation-text=[Source: AUTOSAR_SWS_DiagnosticOverIP.pdf, ECUCItemID: ECUC_DoIP_00021, ParentContainer: DoIPGeneral, Type: EcucEnumerationParamDef, RangeOrReferenceTarget: DOIP_GATEWAY The DoIP Entity is a DoIP Gateway., Multiplicity: 1, DefaultValue: Not specified in source, PostBuildVariant: false, Description: Describes the Type of the DoIP node., Relationship: Not specified in source, EvidenceClassification: Explicit, SourceReference: 10.2.3 DoIPGeneral; PDF page 89 (printed page 89)]
    labels=l-4=DoIPUseEIDasGID, annotation-text=[Source: AUTOSAR_SWS_DiagnosticOverIP.pdf, ECUCItemID: ECUC_DoIP_00018, ParentContainer: DoIPGeneral, Type: EcucBooleanParamDef, RangeOrReferenceTarget: Not specified in source, Multiplicity: 1, DefaultValue: Post-Build Variant false, PostBuildVariant: false, Description: Specifies if the DoIP entity shall use its EID if it is the Master for vehicle identification gid on the vehicle identification/vehicle announcement., Relationship: Not specified in source, EvidenceClassification: Explicit, SourceReference: 10.2.3 DoIPGeneral; PDF page 90 (printed page 90)]
    labels=l-4=DoIPVersionInfoApi, annotation-text=[Source: AUTOSAR_SWS_DiagnosticOverIP.pdf, ECUCItemID: ECUC_DoIP_00005, ParentContainer: DoIPGeneral, Type: EcucBooleanParamDef, RangeOrReferenceTarget: Not specified in source, Multiplicity: 1, DefaultValue: false, PostBuildVariant: false, Description: Activates the DoIP_GetVersionInfo() API. TRUE: Enables the DoIP_GetVersionInfo() API. FALSE: DoIP_GetVersionInfo() API is not included., Relationship: Not specified in source, EvidenceClassification: Explicit, SourceReference: 10.2.3 DoIPGeneral; PDF page 90 (printed page 90)]
    labels=l-4=DoIPVinGidMaster, annotation-text=[Source: AUTOSAR_SWS_DiagnosticOverIP.pdf, ECUCItemID: ECUC_DoIP_00017, ParentContainer: DoIPGeneral, Type: EcucBooleanParamDef, RangeOrReferenceTarget: Not specified in source, Multiplicity: 1, DefaultValue: Post-Build Variant false, PostBuildVariant: false, Description: Specifies if the DoIP entity is the Vehicle identification Master for the GID (Group ID)., Relationship: Not specified in source, EvidenceClassification: Explicit, SourceReference: 10.2.3 DoIPGeneral; PDF page 90 (printed page 90)]
    labels=l-4=DoIPVinInvalidityPattern, annotation-text=[Source: AUTOSAR_SWS_DiagnosticOverIP.pdf, ECUCItemID: ECUC_DoIP_00066, ParentContainer: DoIPGeneral, Type: EcucIntegerParamDef, RangeOrReferenceTarget: 0 .. 255, Multiplicity: 1, DefaultValue: Post-Build Variant false, PostBuildVariant: false, Description: Specifies the Byte pattern that is used for response messages if no valid VIN could be retrieved. Only the value ’0’ or ’255’ is allowed"., Relationship: Not specified in source, EvidenceClassification: Explicit, SourceReference: 10.2.3 DoIPGeneral; PDF page 91 (printed page 91)]
    labels=l-4=DoIPFurtherActionByteDirect, annotation-text=[Source: AUTOSAR_SWS_DiagnosticOverIP.pdf, ECUCItemID: ECUC_DoIP_00093, ParentContainer: DoIPFurtherActionByteCallback, Type: EcucFunctionNameDef, RangeOrReferenceTarget: Not specified in source, Multiplicity: 0..1, DefaultValue: Regular Expression, PostBuildVariant: Not specified in source, Description: Direct C Callback function to get the OEM specific Further Action Byte for the DoIP vehicle identification response/vehicle announcement. If the DoIPFurtherActionByteDirect parameter is present, the DoIP module will not use an RPort of ServiceInterface "CBGetFurtherActionByte" but will call the configured function., Relationship: Not specified in source, EvidenceClassification: Explicit, SourceReference: 10.2.4 DoIPFurtherActionByteCallback; PDF page 94 (printed page 94)]
    labels=l-4=DoIPGetGidDirect, annotation-text=[Source: AUTOSAR_SWS_DiagnosticOverIP.pdf, ECUCItemID: ECUC_DoIP_00028, ParentContainer: DoIPGetGidCallback, Type: EcucFunctionNameDef, RangeOrReferenceTarget: Not specified in source, Multiplicity: 0..1, DefaultValue: Regular Expression, PostBuildVariant: false, Description: If the DoIPGetGidDirect parameter exist the DoIP module shall call the configured callback function (<User>_DoIPGetGID) direct. (It is not needed to specify a service port to the DoIP service component.) If the DoIPGetGidDirect parameter does NOT exist the DoIP module shall use a RPort with a CallbackGetGID type of client-server port interface to retrive the GID., Relationship: Not specified in source, EvidenceClassification: Explicit, SourceReference: 10.2.5 DoIPGetGidCallback; PDF page 95 (printed page 95)]
    labels=l-4=DoIPPowerModeDirect, annotation-text=[Source: AUTOSAR_SWS_DiagnosticOverIP.pdf, ECUCItemID: ECUC_DoIP_00027, ParentContainer: DoIPPowerModeCallback, Type: EcucFunctionNameDef, RangeOrReferenceTarget: Not specified in source, Multiplicity: 0..1, DefaultValue: Regular Expression, PostBuildVariant: false, Description: If the DoIPPowerModeDirect parameter exist the DoIP module shall call the configured callback function (<User>_DoIPGetPowerModeCallback) direct. (It is not needed to specify a service port to the DoIP service component.) If the DoIPPowerModeDirect parameter does NOT present the DoIP module shall use a RPort with a CallbackGetPowerMode type of client-server port interface to retrive the current power mode., Relationship: Not specified in source, EvidenceClassification: Explicit, SourceReference: 10.2.6 DoIPPowerModeCallback; PDF page 96 (printed page 96)]
    labels=l-4=DoIPTriggerGidSyncDirect, annotation-text=[Source: AUTOSAR_SWS_DiagnosticOverIP.pdf, ECUCItemID: ECUC_DoIP_00029, ParentContainer: DoIPTriggerGidSyncCallback, Type: EcucFunctionNameDef, RangeOrReferenceTarget: Not specified in source, Multiplicity: 0..1, DefaultValue: Regular Expression, PostBuildVariant: false, Description: If the DoIPTriggerGidSyncDirect parameter exist the DoIP module shall call the configured callback function (<User>_DoIPTriggerGidSyncCallback) direct. (It is not needed to specify a service port to the DoIP service component.) If the DoIPTriggerGidSyncDirect parameter does NOT present the DoIP module shall use a RPort with a CallbackTriggerGIDSynchnonization type of client-server port interface to trigger the GID synchronization., Relationship: Not specified in source, EvidenceClassification: Explicit, SourceReference: 10.2.7 DoIPTriggerGidSyncCallback; PDF page 96 (printed page 96)]
    labels=l-4=DoIPEid, annotation-text=[Source: AUTOSAR_SWS_DiagnosticOverIP.pdf, ECUCItemID: ECUC_DoIP_00014, ParentContainer: DoIPConfigSet, Type: EcucIntegerParamDef, RangeOrReferenceTarget: 0 .. 281474976710655, Multiplicity: 0..1, DefaultValue: 97 of 126 Document ID 418: AUTOSAR_SWS_DiagnosticOverIP, PostBuildVariant: true, Description: Configured EID (Entity ID of) for vehicle identification/vehicle announcement. Only necessary if DoIPUseMacAddressForIdentification is set to FALSE., Relationship: Not specified in source, EvidenceClassification: Explicit, SourceReference: 10.2.8 DoIPConfigSet; PDF page 97 (printed page 97)]
    labels=l-4=DoIPGid, annotation-text=[Source: AUTOSAR_SWS_DiagnosticOverIP.pdf, ECUCItemID: ECUC_DoIP_00015, ParentContainer: DoIPConfigSet, Type: EcucIntegerParamDef, RangeOrReferenceTarget: 0 .. 281474976710655, Multiplicity: 0..1, DefaultValue: Post-Build Variant true, PostBuildVariant: true, Description: Configured GID (Group ID of) for vehicle identification/vehicle announcement., Relationship: Not specified in source, EvidenceClassification: Explicit, SourceReference: 10.2.8 DoIPConfigSet; PDF page 97 (printed page 97)]
    labels=l-4=DoIPLogicalAddress, annotation-text=[Source: AUTOSAR_SWS_DiagnosticOverIP.pdf, ECUCItemID: ECUC_DoIP_00020, ParentContainer: DoIPConfigSet, Type: EcucIntegerParamDef, RangeOrReferenceTarget: 0 .. 65535, Multiplicity: 1, DefaultValue: Post-Build Variant true, PostBuildVariant: true, Description: Describes the logical address of the DoIP entity, i.e. the LA that will route diagnostic requests to the Dcm of the DoIP entity., Relationship: Not specified in source, EvidenceClassification: Explicit, SourceReference: 10.2.8 DoIPConfigSet; PDF page 98 (printed page 98)]
    labels=l-4=DoIPInterface, annotation-text=[Source: AUTOSAR_SWS_DiagnosticOverIP.pdf, ECUCItemID: ECUC_DoIP_00100, ParentContainer: DoIPConfigSet, Type: EcucParamConfContainerDef, RangeOrReferenceTarget: Not specified in source, Multiplicity: 1..255, DefaultValue: Not specified in source, PostBuildVariant: false, Description: This container defines a logical IP interface and collects properties to configure this interface., Relationship: Contains DoIPInterface configuration parameters and the subcontainers DoIPChannel, DoIPConnections, DoIPFurtherActionByteCallback, DoIPRoutingActivation, and DoIPTester., EvidenceClassification: Explicit, SourceReference: 10.2.9 DoIPInterface; PDF pages 99–105 (printed pages 99–105)]
    labels=l-4=DoIPAliveCheckResponseTimeout, annotation-text=[Source: AUTOSAR_SWS_DiagnosticOverIP.pdf, ECUCItemID: ECUC_DoIP_00009, ParentContainer: DoIPInterface, Type: EcucFloatParamDef, RangeOrReferenceTarget: [0 .. INF], Multiplicity: 1, DefaultValue: Post-Build Variant false, PostBuildVariant: false, Description: Timeout in [s] for waiting for a response to an Alive Check request before the connection is considered to be disconnected. Represents parameter T_TCP_AliveCheck of ISO 13400-2:2012., Relationship: Not specified in source, EvidenceClassification: Explicit, SourceReference: 10.2.9 DoIPInterface; PDF page 99 (printed page 99)]
    labels=l-4=DoIPGeneralInactivityTime, annotation-text=[Source: AUTOSAR_SWS_DiagnosticOverIP.pdf, ECUCItemID: ECUC_DoIP_00068, ParentContainer: DoIPInterface, Type: EcucFloatParamDef, RangeOrReferenceTarget: ]0 .. INF[, Multiplicity: 1, DefaultValue: Post-Build Variant false, PostBuildVariant: false, Description: Timeout in [s] for maximum inactivity of a TCP socket connection before the DoIP module will close the according socket connection. Represents parameter T_TCP_General_Inactivity of ISO 13400-2:2012, Relationship: Not specified in source, EvidenceClassification: Explicit, SourceReference: 10.2.9 DoIPInterface; PDF page 100 (printed page 100)]
    labels=l-4=DoIPInitialInactivityTime, annotation-text=[Source: AUTOSAR_SWS_DiagnosticOverIP.pdf, ECUCItemID: ECUC_DoIP_00010, ParentContainer: DoIPInterface, Type: EcucFloatParamDef, RangeOrReferenceTarget: ]0 .. INF[, Multiplicity: 1, DefaultValue: Post-Build Variant false, PostBuildVariant: false, Description: Timeout in [s] used for initial inactivity of a connected TCP socket connection directly after socket connection. Represents parameter T_TCP_Initial_Inactivity of ISO 13400-2:2012, Relationship: Not specified in source, EvidenceClassification: Explicit, SourceReference: 10.2.9 DoIPInterface; PDF page 100 (printed page 100)]
    labels=l-4=DoIPInitialVehicleAnnouncementTime, annotation-text=[Source: AUTOSAR_SWS_DiagnosticOverIP.pdf, ECUCItemID: ECUC_DoIP_00008, ParentContainer: DoIPInterface, Type: EcucFloatParamDef, RangeOrReferenceTarget: [0 .. INF], Multiplicity: 1, DefaultValue: Post-Build Variant false, PostBuildVariant: false, Description: Time to wait in [s] for sending first vehicle anouncement message after IP address assignment. Represents parameter A_DoIP_Announce_Wait of ISO 13400-2:2012, Relationship: Not specified in source, EvidenceClassification: Explicit, SourceReference: 10.2.9 DoIPInterface; PDF page 100 (printed page 100)]
    labels=l-4=DoIPInterfaceActLineCtrl, annotation-text=[Source: AUTOSAR_SWS_DiagnosticOverIP.pdf, ECUCItemID: ECUC_DoIP_00101, ParentContainer: DoIPInterface, Type: EcucBooleanParamDef, RangeOrReferenceTarget: Not specified in source, Multiplicity: 1, DefaultValue: Post-Build Variant false, PostBuildVariant: false, Description: This attribute defines whether the network interface • is started "on-demand" when an activation line is sensed (TRUE) or • is always available (FALSE)., Relationship: Not specified in source, EvidenceClassification: Explicit, SourceReference: 10.2.9 DoIPInterface; PDF page 101 (printed page 101)]
    labels=l-4=DoIPInterfaceAnnouncementStart, annotation-text=[Source: AUTOSAR_SWS_DiagnosticOverIP.pdf, ECUCItemID: ECUC_DoIP_00099, ParentContainer: DoIPInterface, Type: EcucEnumerationParamDef, RangeOrReferenceTarget: DOIP_AUTOMATIC_ANN AUTOMATIC announcement, Multiplicity: 1, DefaultValue: DOIP_AUTOMATIC_ANNOUNCE, PostBuildVariant: false, Description: This attribute defines, when vehicle announcement is started on a DoIPInterface • Automatic: As soon as the underlying UDP vehicle announcement connection switches to SOAD_SOCON_ONLINE • OnTrigger: As soon as the API DoIP_TriggerVehicleAnnouncement is called for the given DoIPInterface instance, Relationship: Not specified in source, EvidenceClassification: Explicit, SourceReference: 10.2.9 DoIPInterface; PDF page 101 (printed page 101)]
    labels=l-4=DoIPInterfaceId, annotation-text=[Source: AUTOSAR_SWS_DiagnosticOverIP.pdf, ECUCItemID: ECUC_DoIP_00098, ParentContainer: DoIPInterface, Type: EcucIntegerParamDef (Symbolic Name generated for this parameter), RangeOrReferenceTarget: 0 .. 255, Multiplicity: 1, DefaultValue: Post-Build Variant false, PostBuildVariant: false, Description: This parameter is an identifier of the DoIPInterface. The value of this parameter will be assigned to the symbolic name derived from the container short name., Relationship: Not specified in source, EvidenceClassification: Explicit, SourceReference: 10.2.9 DoIPInterface; PDF page 102 (printed page 102)]
    labels=l-4=DoIPMaxTesterConnections, annotation-text=[Source: AUTOSAR_SWS_DiagnosticOverIP.pdf, ECUCItemID: ECUC_DoIP_00012, ParentContainer: DoIPInterface, Type: EcucIntegerParamDef, RangeOrReferenceTarget: 1 .. 255, Multiplicity: 1, DefaultValue: Post-Build Variant false, PostBuildVariant: false, Description: Maximum amount of tester connections that shall be maintained at one time before alive check is performed., Relationship: Not specified in source, EvidenceClassification: Explicit, SourceReference: 10.2.9 DoIPInterface; PDF page 102 (printed page 102)]
    labels=l-4=DoIPUseMacAddressForIdentification, annotation-text=[Source: AUTOSAR_SWS_DiagnosticOverIP.pdf, ECUCItemID: ECUC_DoIP_00013, ParentContainer: DoIPInterface, Type: EcucBooleanParamDef, RangeOrReferenceTarget: Not specified in source, Multiplicity: 1, DefaultValue: Post-Build Variant false, PostBuildVariant: false, Description: Provided the information if a configured EID at vehicle identification response/vehicle announment is used or the MAC address. TRUE: Use MAC Address instead of EID for Vehicle identification/announcement. FALSE: Use configured EID for vehicle identification/announcement. Dependencies: DoIPEID, Relationship: Not specified in source, EvidenceClassification: Explicit, SourceReference: 10.2.9 DoIPInterface; PDF page 102 (printed page 102)]
    labels=l-4=DoIPUseVehicleIdentificationSyncStatus, annotation-text=[Source: AUTOSAR_SWS_DiagnosticOverIP.pdf, ECUCItemID: ECUC_DoIP_00016, ParentContainer: DoIPInterface, Type: EcucBooleanParamDef, RangeOrReferenceTarget: Not specified in source, Multiplicity: 1, DefaultValue: Post-Build Variant false, PostBuildVariant: false, Description: Defines if the optional VIN/GID synchronization status is used additionally in the vehicle identification/announcement., Relationship: Not specified in source, EvidenceClassification: Explicit, SourceReference: 10.2.9 DoIPInterface; PDF page 103 (printed page 103)]
    labels=l-4=DoIPVehicleAnnouncementCount, annotation-text=[Source: AUTOSAR_SWS_DiagnosticOverIP.pdf, ECUCItemID: ECUC_DoIP_00094, ParentContainer: DoIPInterface, Type: EcucIntegerParamDef, RangeOrReferenceTarget: 1 .. 255, Multiplicity: 0..1, DefaultValue: Post-Build Variant false, PostBuildVariant: false, Description: Number of vehicle announcement messages on IP address assignment. Represents parameter A_DoIP_Announce_Num of ISO 13400-2:2012., Relationship: Not specified in source, EvidenceClassification: Explicit, SourceReference: 10.2.9 DoIPInterface; PDF page 103 (printed page 103)]
    labels=l-4=DoIPVehicleAnnouncementInterval, annotation-text=[Source: AUTOSAR_SWS_DiagnosticOverIP.pdf, ECUCItemID: ECUC_DoIP_00007, ParentContainer: DoIPInterface, Type: EcucFloatParamDef, RangeOrReferenceTarget: [0 .. INF], Multiplicity: 0..1, DefaultValue: Post-Build Variant false, PostBuildVariant: false, Description: Time to wait in [s] for sending subsequent vehicle anouncement messages. Represents parameter A_DoIP_Announce_Interval of ISO 13400-2:2012, Relationship: Not specified in source, EvidenceClassification: Explicit, SourceReference: 10.2.9 DoIPInterface; PDF page 104 (printed page 104)]
    labels=l-4=DoIPChannel, annotation-text=[Source: AUTOSAR_SWS_DiagnosticOverIP.pdf, ECUCItemID: ECUC_DoIP_00069, ContainerName: DoIPChannel, ParentContainer: DoIPInterface, Type: Container, RangeOrReferenceTarget: Not specified in source, Multiplicity: 1 .. 65535, DefaultValue: Not specified in source, PostBuildVariant: false, Description: Configuration of one DoIPChannel., Relationship: DoIPChannel belongs to DoIPInterface. It contains configuration parameters DoIPChannelSARef and DoIPChannelTARef. It may contain DoIPPduRRxPdu and DoIPPduRTxPdu., EvidenceClassification: Explicit, SourceReference: Section 10.2.10, PDF page 106, printed page 106.]
    labels=l-4=DoIPChannelSARef, annotation-text=[Source: AUTOSAR_SWS_DiagnosticOverIP.pdf, ECUCItemID: ECUC_DoIP_00070, ParentContainer: DoIPChannel, Type: Reference to DoIPTester, RangeOrReferenceTarget: Not specified in source, Multiplicity: 1, DefaultValue: Not specified in source, PostBuildVariant: Value, Description: Reference to the DoIPTester., Relationship: Not specified in source, EvidenceClassification: Explicit, SourceReference: 10.2.10 DoIPChannel; PDF page 105 (printed page 105)]
    labels=l-4=DoIPChannelTARef, annotation-text=[Source: AUTOSAR_SWS_DiagnosticOverIP.pdf, ECUCItemID: ECUC_DoIP_00071, ParentContainer: DoIPChannel, Type: Reference to DoIPTargetAddress, RangeOrReferenceTarget: Not specified in source, Multiplicity: 1, DefaultValue: Not specified in source, PostBuildVariant: Value, Description: Reference to the target address., Relationship: Not specified in source, EvidenceClassification: Explicit, SourceReference: 10.2.10 DoIPChannel; PDF page 106 (printed page 106)]
    labels=l-4=DoIPPduRRxPdu, annotation-text=[Source: AUTOSAR_SWS_DiagnosticOverIP.pdf, ECUCItemID: ECUC_DoIP_00055, ParentContainer: DoIPChannel, Type: EcucParamConfContainerDef, Description: This container contains the Rx Pdus to connect with the Rx Pdus of the PduR., Multiplicity: 0 .. 1, PostBuildVariant: Not specified in this container definition, Relationship: Contains DoIPPduRRxPduId and DoIPPduRRxPduRef., EvidenceClassification: Explicit, SourceReference: Section 10.2.11, PDF page 107, printed page 107.]
    labels=l-4=DoIPPduRRxPduId, annotation-text=[Source: AUTOSAR_SWS_DiagnosticOverIP.pdf, ECUCItemID: ECUC_DoIP_00057, ParentContainer: DoIPPduRRxPdu, Type: EcucIntegerParamDef (Symbolic Name generated for this parameter), RangeOrReferenceTarget: 0 .. 65535, Multiplicity: 1, DefaultValue: Post-Build Variant false, PostBuildVariant: false, Description: The DoIPPduRRxPduId is required by the API call DoIP_TpCancelReceive., Relationship: Not specified in source, EvidenceClassification: Explicit, SourceReference: 10.2.11 DoIPPduRRxPdu; PDF page 107 (printed page 107)]
    labels=l-4=DoIPPduRRxPduRef, annotation-text=[Source: AUTOSAR_SWS_DiagnosticOverIP.pdf, ECUCItemID: ECUC_DoIP_00058, ParentContainer: DoIPPduRRxPdu, Type: Reference to Pdu, RangeOrReferenceTarget: Not specified in source, Multiplicity: 1, DefaultValue: Not specified in source, PostBuildVariant: Value, Description: Reference to the "global" Pdu structure to allow harmonization of handle IDs in the COM-Stack., Relationship: Not specified in source, EvidenceClassification: Explicit, SourceReference: 10.2.11 DoIPPduRRxPdu; PDF page 108 (printed page 108)]
    labels=l-4=DoIPPduRTxPdu, annotation-text=[Source: AUTOSAR_SWS_DiagnosticOverIP.pdf, ECUCItemID: ECUC_DoIP_00056, ParentContainer: DoIPChannel, Description: This container contains the Tx Pdus to connect with the Tx Pdus of the PduR. If the parameter is not configured the channel is for functional addressing., Multiplicity: 0 .. 1, PostBuildVariant: Not specified in this container definition, Relationship: Contains DoIPPduRTxPduId, DoIPPduType and DoIPPduRTxPduRef., EvidenceClassification: Explicit, SourceReference: Section 10.2.12, PDF page 108, printed page 108.]
    labels=l-4=DoIPPduRTxPduId, annotation-text=[Source: AUTOSAR_SWS_DiagnosticOverIP.pdf, ECUCItemID: ECUC_DoIP_00060, ParentContainer: DoIPPduRTxPdu, Type: EcucIntegerParamDef (Symbolic Name generated for this parameter), RangeOrReferenceTarget: 0 .. 65535, Multiplicity: 1, DefaultValue: Post-Build Variant false, PostBuildVariant: false, Description: The DoIPPduRTxPduId is required by DoIP_TpTransmit or DoIP_IfTransmit and DoIP_TpCancelTransmit., Relationship: Not specified in source, EvidenceClassification: Explicit, SourceReference: 10.2.12 DoIPPduRTxPdu; PDF page 108 (printed page 108)]
    labels=l-4=DoIPPduType, annotation-text=[Source: AUTOSAR_SWS_DiagnosticOverIP.pdf, ECUCItemID: ECUC_DoIP_00075, ParentContainer: DoIPPduRTxPdu, Type: EcucEnumerationParamDef, RangeOrReferenceTarget: DOIP_IFPDU DOIP_IFPDU for UUDT messages,, Multiplicity: 0..1, DefaultValue: DOIP_TPPDU, PostBuildVariant: true, Description: API Type to use for communication with PduR. DOIP_IFPDU for UUDT messages, DOIP_TPPDU for all other diagnostic messages., Relationship: Not specified in source, EvidenceClassification: Explicit, SourceReference: 10.2.12 DoIPPduRTxPdu; PDF page 108 (printed page 108)]
    labels=l-4=DoIPPduRTxPduRef, annotation-text=[Source: AUTOSAR_SWS_DiagnosticOverIP.pdf, ECUCItemID: ECUC_DoIP_00059, ParentContainer: DoIPPduRTxPdu, Type: Reference to Pdu, RangeOrReferenceTarget: Not specified in source, Multiplicity: 1, DefaultValue: Not specified in source, PostBuildVariant: Value, Description: Reference to the "global" Pdu structure to allow harmonization of handle IDs in the COM-Stack., Relationship: Not specified in source, EvidenceClassification: Explicit, SourceReference: 10.2.12 DoIPPduRTxPdu; PDF page 109 (printed page 109)]
    labels=l-4=DoIPTargetAddressValue, annotation-text=[Source: AUTOSAR_SWS_DiagnosticOverIP.pdf, ECUCItemID: ECUC_DoIP_00054, ParentContainer: DoIPTargetAddress, Type: EcucIntegerParamDef, Range: 0 .. 65535, Multiplicity: 1, DefaultValue: Not specified in source, PostBuildVariant: true, ValueConfigurationClass: VARIANT-PRE-COMPILE, VARIANT-LINK-TIME, VARIANT-POST-BUILD, Scope: local, Description: Valid Target Address of a DoIP target address., SourceReference: Section 10.2.14, PDF page 112]
    labels=l-4=DoIPTcpConnection, annotation-text=[Source: AUTOSAR_SWS_DiagnosticOverIP.pdf, ECUCItemID: ECUC_DoIP_00045, ParentContainer: DoIPConnections, Type: EcucParamConfContainerDef, RangeOrReferenceTarget: Not specified in source, Multiplicity: 2..255, DefaultValue: Not specified in source, PostBuildVariant: Not specified in source, Description: This container describes a TCP connection to the lower layer SoAd module., Relationship: Contains DoIPRequestAddressAssignment, DoIPTcpConnectionSecurityRequired, DoIPSoAdTcpRxPdu, and DoIPSoAdTcpTxPdu., SourceReference: 10.2.15 DoIPTcpConnection; PDF pages 112–113 (printed pages 112–113)]
    labels=l-4=DoIPRequestAddressAssignment, annotation-text=[Source: AUTOSAR_SWS_DiagnosticOverIP.pdf, ECUCItemID: ECUC_DoIP_00095, ParentContainer: DoIPTcpConnection, Type: EcucBooleanParamDef, RangeOrReferenceTarget: Not specified in source, Multiplicity: 1, DefaultValue: true, PostBuildVariant: false, Description: The DoIP module shall request IP address assignment by calling SoAd_RequestIpAddrAssignment() for the TcpIpLocalAddr related to this DoIpConnection., Relationship: Not specified in source, EvidenceClassification: Explicit, SourceReference: 10.2.15 DoIPTcpConnection; PDF page 112 (printed page 112)]
    labels=l-4=DoIPTcpConnectionSecurityRequired, annotation-text=[Source: AUTOSAR_SWS_DiagnosticOverIP.pdf, ECUCItemID: ECUC_DoIP_00097, ParentContainer: DoIPTcpConnection, Type: EcucBooleanParamDef, RangeOrReferenceTarget: Not specified in source, Multiplicity: 0..1, DefaultValue: false, PostBuildVariant: Not specified in source, Description: Indicates if the associated TCP socket uses a secure connection (e.g. TLS), Relationship: Not specified in source, EvidenceClassification: Explicit, SourceReference: 10.2.15 DoIPTcpConnection; PDF page 112 (printed page 112)]
    labels=l-4=DoIPSoAdTcpRxPdu, annotation-text=[Source: AUTOSAR_SWS_DiagnosticOverIP.pdf, ECUCItemID: ECUC_DoIP_00080, ParentContainer: DoIPTcpConnection, Type: EcucParamConfContainerDef, RangeOrReferenceTarget: Not specified in source, Multiplicity: 1, DefaultValue: Not specified in source, PostBuildVariant: Not specified in source, Description: This container describes a Rx PDU received via SoAd over TCP., Relationship: Contains DoIPSoAdTcpRxPduId and DoIPSoAdTcpRxPduRef., SourceReference: 10.2.16 DoIPSoAdTcpRxPdu; PDF page 113 (printed page 113)]
    labels=l-4=DoIPSoAdTcpRxPduId, annotation-text=[Source: AUTOSAR_SWS_DiagnosticOverIP.pdf, ECUCItemID: ECUC_DoIP_00082, ParentContainer: DoIPSoAdTcpRxPdu, Type: EcucIntegerParamDef (Symbolic Name generated for this parameter), RangeOrReferenceTarget: 0 .. 65535, Multiplicity: 1, DefaultValue: Post-Build Variant false, PostBuildVariant: false, Description: The DoIPSoAdTcpRxPduId is required by the API call DoIP_SoAdTpRxIndication to receive I-PDUs from the SoAd., Relationship: Not specified in source, EvidenceClassification: Explicit, SourceReference: 10.2.16 DoIPSoAdTcpRxPdu; PDF page 113 (printed page 113)]
    labels=l-4=DoIPSoAdTcpRxPduRef, annotation-text=[Source: AUTOSAR_SWS_DiagnosticOverIP.pdf, ECUCItemID: ECUC_DoIP_00083, ParentContainer: DoIPSoAdTcpRxPdu, Type: Reference to Pdu, RangeOrReferenceTarget: Not specified in source, Multiplicity: 1, DefaultValue: Not specified in source, PostBuildVariant: Value, Description: Reference to the "global" Pdu structure to allow harmonization of handle IDs in the COM-Stack., Relationship: Not specified in source, EvidenceClassification: Explicit, SourceReference: 10.2.16 DoIPSoAdTcpRxPdu; PDF page 113 (printed page 113)]
    labels=l-4=DoIPSoAdTcpTxPdu, annotation-text=[Source: AUTOSAR_SWS_DiagnosticOverIP.pdf, ECUCItemID: ECUC_DoIP_00081, ParentContainer: DoIPTcpConnection, Type: EcucParamConfContainerDef, RangeOrReferenceTarget: Not specified in source, Multiplicity: 1, DefaultValue: Not specified in source, PostBuildVariant: Not specified in source, Description: This container describes a Tx PDU sent via SoAd over TCP., Relationship: Contains DoIPSoAdTcpTxPduId and DoIPSoAdTcpTxPduRef., SourceReference: 10.2.17 DoIPSoAdTcpTxPdu; PDF page 114 (printed page 114)]
    labels=l-4=DoIPSoAdTcpTxPduId, annotation-text=[Source: AUTOSAR_SWS_DiagnosticOverIP.pdf, ECUCItemID: ECUC_DoIP_00085, ParentContainer: DoIPSoAdTcpTxPdu, Type: EcucIntegerParamDef (Symbolic Name generated for this parameter), RangeOrReferenceTarget: 0 .. 65535, Multiplicity: 1, DefaultValue: Post-Build Variant false, PostBuildVariant: false, Description: The DoIPSoAdTcpTxPduId is required by the API call DoIP_SoAdTpTxConfirmation that is called by the SoAd to confirm that the IPdu has been transmitted successfully., Relationship: Not specified in source, EvidenceClassification: Explicit, SourceReference: 10.2.17 DoIPSoAdTcpTxPdu; PDF page 114 (printed page 114)]
    labels=l-4=DoIPSoAdTcpTxPduRef, annotation-text=[Source: AUTOSAR_SWS_DiagnosticOverIP.pdf, ECUCItemID: ECUC_DoIP_00084, ParentContainer: DoIPSoAdTcpTxPdu, Type: Reference to Pdu, RangeOrReferenceTarget: Not specified in source, Multiplicity: 1, DefaultValue: Not specified in source, PostBuildVariant: Value, Description: Reference to the "global" Pdu structure to allow harmonization of handle IDs in the COM-Stack., Relationship: Not specified in source, EvidenceClassification: Explicit, SourceReference: 10.2.17 DoIPSoAdTcpTxPdu; PDF page 114 (printed page 114)]
    labels=l-4=DoIPUdpConnection, annotation-text=[Source: AUTOSAR_SWS_DiagnosticOverIP.pdf, ECUCItemID: ECUC_DoIP_00052, ParentContainer: DoIPConnections, Type: EcucParamConfContainerDef, RangeOrReferenceTarget: Not specified in source, Multiplicity: 1..255, DefaultValue: Not specified in source, PostBuildVariant: Not specified in source, Description: This Container describes a Udp connection to the lower layer SoAd module., Relationship: Contains DoIPRequestAddressAssignment, DoIPSoAdUdpRxPdu, and DoIPSoAdUdpTxPdu., SourceReference: 10.2.18 DoIPUdpConnection; PDF page 115 (printed page 115)]
    labels=l-4=DoIPRequestAddressAssignment, annotation-text=[Source: AUTOSAR_SWS_DiagnosticOverIP.pdf, ECUCItemID: ECUC_DoIP_00095, ParentContainer: DoIPUdpConnection, Type: EcucBooleanParamDef, RangeOrReferenceTarget: Not specified in source, Multiplicity: 1, DefaultValue: true, PostBuildVariant: false, Description: The DoIP module shall request IP address assignment by calling SoAd_RequestIpAddrAssignment() for the TcpIpLocalAddr related to this DoIpConnection., Relationship: Not specified in source, EvidenceClassification: Explicit, SourceReference: 10.2.18 DoIPUdpConnection; PDF page 115 (printed page 115)]
    labels=l-4=DoIPSoAdUdpRxPdu, annotation-text=[Source: AUTOSAR_SWS_DiagnosticOverIP.pdf, ECUCItemID: ECUC_DoIP_00046, ParentContainer: DoIPUdpConnection, Type: EcucParamConfContainerDef, RangeOrReferenceTarget: Not specified in source, Multiplicity: 1, DefaultValue: Not specified in source, PostBuildVariant: Not specified in source, Description: This container describes a Rx PDU received via SoAd over UDP., Relationship: Contains DoIPSoAdUdpRxPduId and DoIPSoAdUdpRxPduRef., SourceReference: 10.2.19 DoIPSoAdUdpRxPdu; PDF page 116 (printed page 116)]
    labels=l-4=DoIPSoAdUdpRxPduId, annotation-text=[Source: AUTOSAR_SWS_DiagnosticOverIP.pdf, ECUCItemID: ECUC_DoIP_00048, ParentContainer: DoIPSoAdUdpRxPdu, Type: EcucIntegerParamDef (Symbolic Name generated for this parameter), RangeOrReferenceTarget: 0 .. 65535, Multiplicity: 1, DefaultValue: Post-Build Variant false, PostBuildVariant: false, Description: The DoIPSoAdUdpRxPduId is required by the API call DoIP_SoAdIfRxIndication to receive I-PDUs from the SoAd., Relationship: Not specified in source, EvidenceClassification: Explicit, SourceReference: 10.2.19 DoIPSoAdUdpRxPdu; PDF page 115 (printed page 115)]
    labels=l-4=DoIPSoAdUdpRxPduRef, annotation-text=[Source: AUTOSAR_SWS_DiagnosticOverIP.pdf, ECUCItemID: ECUC_DoIP_00049, ParentContainer: DoIPSoAdUdpRxPdu, Type: Reference to Pdu, RangeOrReferenceTarget: Not specified in source, Multiplicity: 1, DefaultValue: Not specified in source, PostBuildVariant: Value, Description: Reference to the "global" Pdu structure to allow harmonization of handle IDs in the COM-Stack., Relationship: Not specified in source, EvidenceClassification: Explicit, SourceReference: 10.2.19 DoIPSoAdUdpRxPdu; PDF page 116 (printed page 116)]
    labels=l-4=DoIPSoAdUdpTxPdu, annotation-text=[Source: AUTOSAR_SWS_DiagnosticOverIP.pdf, ECUCItemID: ECUC_DoIP_00047, ParentContainer: DoIPUdpConnection, Type: EcucParamConfContainerDef, RangeOrReferenceTarget: Not specified in source, Multiplicity: 1, DefaultValue: Not specified in source, PostBuildVariant: Not specified in source, Description: This container describes a Tx PDU sent via SoAd over UDP., Relationship: Contains DoIPSoAdUdpTxPduId and DoIPSoAdUdpTxPduRef., SourceReference: 10.2.20 DoIPSoAdUdpTxPdu; PDF pages 116–117 (printed pages 116–117)]
    labels=l-4=DoIPSoAdUdpTxPduId, annotation-text=[Source: AUTOSAR_SWS_DiagnosticOverIP.pdf, ECUCItemID: ECUC_DoIP_00051, ParentContainer: DoIPSoAdUdpTxPdu, Type: EcucIntegerParamDef (Symbolic Name generated for this parameter), RangeOrReferenceTarget: 0 .. 65535, Multiplicity: 1, DefaultValue: Post-Build Variant false, PostBuildVariant: false, Description: The DoIPSoAdUdpTxPduId is required by the API call DoIP_SoAdIfTxConfirmation that is called by the SoAd to confirm that the IPdu has been transmitted successfully., Relationship: Not specified in source, EvidenceClassification: Explicit, SourceReference: 10.2.20 DoIPSoAdUdpTxPdu; PDF page 116 (printed page 116)]
    labels=l-4=DoIPSoAdUdpTxPduRef, annotation-text=[Source: AUTOSAR_SWS_DiagnosticOverIP.pdf, ECUCItemID: ECUC_DoIP_00050, ParentContainer: DoIPSoAdUdpTxPdu, Type: Reference to Pdu, RangeOrReferenceTarget: Not specified in source, Multiplicity: 1, DefaultValue: Not specified in source, PostBuildVariant: Value, Description: Reference to the "global" Pdu structure to allow harmonization of handle IDs in the COM-Stack., Relationship: Not specified in source, EvidenceClassification: Explicit, SourceReference: 10.2.20 DoIPSoAdUdpTxPdu; PDF page 117 (printed page 117)]
    labels=l-4=DoIPUdpVehicleAnnouncementConnection, annotation-text=[Source: AUTOSAR_SWS_DiagnosticOverIP.pdf, ECUCItemID: ECUC_DoIP_00076, ParentContainer: DoIPConnections, Type: EcucParamConfContainerDef, RangeOrReferenceTarget: Not specified in source, Multiplicity: 0..255, DefaultValue: Not specified in source, PostBuildVariant: Not specified in source, Description: This container describes the UDP multicast connections to the lower layer SoAd module., Relationship: Contains DoIPRequestAddressAssignment and DoIPSoAdUdpVehicleAnnouncementTxPdu., SourceReference: 10.2.21 DoIPUdpVehicleAnnouncementConnection; PDF pages 117–118 (printed pages 117–118)]
    labels=l-4=DoIPRequestAddressAssignment, annotation-text=[Source: AUTOSAR_SWS_DiagnosticOverIP.pdf, ECUCItemID: ECUC_DoIP_00095, ParentContainer: DoIPUdpVehicleAnnouncementConnection, Type: EcucBooleanParamDef, RangeOrReferenceTarget: Not specified in source, Multiplicity: 1, DefaultValue: true, PostBuildVariant: false, Description: The DoIP module shall request IP address assignment by calling SoAd_RequestIpAddrAssignment() for the TcpIpLocalAddr related to this DoIpConnection., Relationship: Not specified in source, EvidenceClassification: Explicit, SourceReference: 10.2.21 DoIPUdpVehicleAnnouncementConnection; PDF page 117 (printed page 117)]
    labels=l-4=DoIPSoAdUdpVehicleAnnouncementTxPdu, annotation-text=[Source: AUTOSAR_SWS_DiagnosticOverIP.pdf, ECUCItemID: ECUC_DoIP_00077, ParentContainer: DoIPUdpVehicleAnnouncementConnection, Type: EcucParamConfContainerDef, RangeOrReferenceTarget: Not specified in source, Multiplicity: 1, DefaultValue: Not specified in source, PostBuildVariant: Not specified in source, Description: This container describes the vehicle announcement TxPdu sent via the SoAd., Relationship: Contains DoIPSoAdUdpVehicleAnnouncementTxPduId and DoIPSoAdUdpVehicleAnnouncementTxPduRef., SourceReference: 10.2.22 DoIPSoAdUdpVehicleAnnouncementTxPdu; PDF pages 118–119 (printed pages 118–119)]
    labels=l-4=DoIPSoAdUdpVehicleAnnouncementTxPduId, annotation-text=[Source: AUTOSAR_SWS_DiagnosticOverIP.pdf, ECUCItemID: ECUC_DoIP_00078, ParentContainer: DoIPSoAdUdpVehicleAnnouncementTxPdu, Type: EcucIntegerParamDef (Symbolic Name generated for this parameter), RangeOrReferenceTarget: 0 .. 4294967295, Multiplicity: 1, DefaultValue: Post-Build Variant false, PostBuildVariant: false, Description: The DoIPSoAdUdpVehicleAnnouncementTxPduId is required by the API call DoIP_SoAdIfTxConfirmation() that is called by the SoAd to confirm that the IPdu has been transmitted successfully., Relationship: Not specified in source, EvidenceClassification: Explicit, SourceReference: 10.2.22 DoIPSoAdUdpVehicleAnnouncementTxPdu; PDF page 118 (printed page 118)]
    labels=l-4=DoIPSoAdUdpVehicleAnnouncementTxPduRef, annotation-text=[Source: AUTOSAR_SWS_DiagnosticOverIP.pdf, ECUCItemID: ECUC_DoIP_00079, ParentContainer: DoIPSoAdUdpVehicleAnnouncementTxPdu, Type: Reference to Pdu, RangeOrReferenceTarget: Not specified in source, Multiplicity: 1, DefaultValue: Not specified in source, PostBuildVariant: Value, Description: Reference to the "global" PDU structure to allow harmonization of handle IDs in the COM-Stack., Relationship: Not specified in source, EvidenceClassification: Explicit, SourceReference: 10.2.22 DoIPSoAdUdpVehicleAnnouncementTxPdu; PDF page 118 (printed page 118)]
    labels=l-4=DoIPRoutingActivation, annotation-text=[Source: AUTOSAR_SWS_DiagnosticOverIP.pdf, ECUCItemID: ECUC_DoIP_00030, ParentContainer: DoIPInterface, Type: EcucParamConfContainerDef, RangeOrReferenceTarget: Not specified in source, Multiplicity: 0..255, DefaultValue: Not specified in source, PostBuildVariant: false, Description: This container describes the routing activation possibilities by representing for each container a possible routing activation request message to the DoIP entity and the according references to the activated diagnostic messages., Relationship: Contains DoIPRoutingActivationNumber, DoIPTargetAddressRef, and DoIPRoutingActivationSecurityRequired. Includes DoIPRoutingActivationAuthenticationCallback and DoIPRoutingActivationConfirmationCallback., EvidenceClassification: Explicit, SourceReference: 10.2.23 DoIPRoutingActivation; PDF page 119 (printed page 119)]
    labels=l-4=DoIPRoutingActivationNumber, annotation-text=[Source: AUTOSAR_SWS_DiagnosticOverIP.pdf, ECUCItemID: ECUC_DoIP_00033, ParentContainer: DoIPRoutingActivation, Type: EcucIntegerParamDef, RangeOrReferenceTarget: 0 .. 255, Multiplicity: 1, DefaultValue: Post-Build Variant true, PostBuildVariant: true, Description: Identifies the Routing activation Number which is received for a DoIP routing activation request message., Relationship: Not specified in source, EvidenceClassification: Explicit, SourceReference: 10.2.23 DoIPRoutingActivation; PDF page 119 (printed page 119)]
    labels=l-4=DoIPRoutingActivationSecurityRequired, annotation-text=[Source: AUTOSAR_SWS_DiagnosticOverIP.pdf, ECUCItemID: ECUC_DoIP_00096, ParentContainer: DoIPRoutingActivation, Type: EcucBooleanParamDef, RangeOrReferenceTarget: Not specified in source, Multiplicity: 0..1, DefaultValue: false, PostBuildVariant: Not specified in source, Description: Indicates if a routing activation requires a secure TCP connection, Relationship: Not specified in source, EvidenceClassification: Explicit, SourceReference: 10.2.23 DoIPRoutingActivation; PDF page 119 (printed page 119)]
    labels=l-4=DoIPConnections, annotation-text=[Source: AUTOSAR_SWS_DiagnosticOverIP.pdf, ECUCItemID: ECUC_DoIP_00032, ParentContainer: DoIPInterface, Type: Not specified in source, RangeOrReferenceTarget: Not specified in source, Multiplicity: 0 ... 1, DefaultValue: Not specified in source, PostBuildVariant: false, Description: Container contains all lower layer connection specific information, i.e. the single Pdu References and Handle IDs to the SoAd., Relationship: Contains DoIPTargetAddress, DoIPTcpConnection, DoIPUdpConnection, and DoIPUdpVehicleAnnouncementConnection., SourceReference: 10.2.13 DoIPConnections; PDF page 110 (printed page 110)]
    labels=l-4=DoIPTargetAddressRef, annotation-text=[Source: AUTOSAR_SWS_DiagnosticOverIP.pdf, ECUCItemID: ECUC_DoIP_00034, ParentContainer: DoIPRoutingActivation, Type: Reference to DoIPTargetAddress, RangeOrReferenceTarget: Not specified in source, Multiplicity: 1..65535, DefaultValue: Not specified in source, PostBuildVariant: true, Description: Reference to all DoIPTargetAddress which are activated on this Routing activation., Relationship: Not specified in source, EvidenceClassification: Explicit, SourceReference: 10.2.23 DoIPRoutingActivation; PDF page 120 (printed page 120)]
    labels=l-4=DoIPRoutingActivationAuthenticationCallback, annotation-text=[Source: AUTOSAR_SWS_DiagnosticOverIP.pdf, ECUCItemID: ECUC_DoIP_00035, ParentContainer: DoIPRoutingActivation, Type: EcucParamConfContainerDef, RangeOrReferenceTarget: Not specified in source, Multiplicity: 0..1, DefaultValue: Not specified in source, PostBuildVariant: Not specified in source, Description: Container describes the Callbackfunction to call on a Routing Activation Request for Authentication. If this container is configured but the DoIPRoutingActivationAuthenticationFunc parameter is not present, the DoIP module will use an RPort of ServiceInterface <RoutingActivation>_RoutingActivation with the name "CB<RoutingActivation>RoutingActivation". <RoutingActivation> is the ShortName of the DoIPRoutingActiviation container., Relationship: Contains DoIPRoutingActivationAuthenticationFunc, DoIPRoutingActivationAuthenticationReqLength, and DoIPRoutingActivationAuthenticationResLength., EvidenceClassification: Explicit, SourceReference: 10.2.24 DoIPRoutingActivationAuthenticationCallback; PDF page 121 (printed page 121)]
    labels=l-4=DoIPRoutingActivationAuthenticationFunc, annotation-text=[Source: AUTOSAR_SWS_DiagnosticOverIP.pdf, ECUCItemID: ECUC_DoIP_00039, ParentContainer: DoIPRoutingActivationAuthenticationCallback, Type: EcucFunctionNameDef, RangeOrReferenceTarget: Not specified in source, Multiplicity: 0..1, DefaultValue: Regular Expression, PostBuildVariant: false, Description: Direct C Callback function to trigger the authentication function for routing activation. If the DoIPRoutingActivationAuthenticationFunc parameter is present, the DoIP module will not use an RPort of ServiceInterface <RoutingActivation>_RoutingActivation but call the configured function., Relationship: Not specified in source, EvidenceClassification: Explicit, SourceReference: 10.2.24 DoIPRoutingActivationAuthenticationCallback; PDF page 121 (printed page 121)]
    labels=l-4=DoIPRoutingActivationAuthenticationReqLength, annotation-text=[Source: AUTOSAR_SWS_DiagnosticOverIP.pdf, ECUCItemID: ECUC_DoIP_00040, ParentContainer: DoIPRoutingActivationAuthenticationCallback, Type: EcucIntegerParamDef, RangeOrReferenceTarget: 0 .. 4, Multiplicity: 1, DefaultValue: Post-Build Variant false, PostBuildVariant: false, Description: Describes the amount of bytes used to handle to the authentication function on routing activation. If 0 is configured as length the parameter AuthenticationReqData will not be handled to the API., Relationship: Not specified in source, EvidenceClassification: Explicit, SourceReference: 10.2.24 DoIPRoutingActivationAuthenticationCallback; PDF page 122 (printed page 122)]
    labels=l-4=DoIPRoutingActivationAuthenticationResLength, annotation-text=[Source: AUTOSAR_SWS_DiagnosticOverIP.pdf, ECUCItemID: ECUC_DoIP_00041, ParentContainer: DoIPRoutingActivationAuthenticationCallback, Type: EcucIntegerParamDef, RangeOrReferenceTarget: 0 .. 4, Multiplicity: 1, DefaultValue: Post-Build Variant false, PostBuildVariant: false, Description: Describes the amount of bytes used to read by the authentication function on routing activation. If 0 is configured as length the parameter AuthenticationResData will not be fetched via the API., Relationship: Not specified in source, EvidenceClassification: Explicit, SourceReference: 10.2.24 DoIPRoutingActivationAuthenticationCallback; PDF page 122 (printed page 122)]
    labels=l-4=DoIPRoutingActivationConfirmationCallback, annotation-text=[Source: AUTOSAR_SWS_DiagnosticOverIP.pdf, ECUCItemID: ECUC_DoIP_00061, ParentContainer: DoIPRoutingActivation, Type: EcucParamConfContainerDef, RangeOrReferenceTarget: Not specified in source, Multiplicity: 0..1, DefaultValue: Not specified in source, PostBuildVariant: Not specified in source, Description: Container describes the Callbackfunction to call on a Routing Activation Request for Confirmation. If this container is configured but the DoIPRoutingActivationConfirmationFunc parameter is not present the DoIP module will use an RPort of ServiceInterface <RoutingActivation>_RoutingActivation with the name "CB<RoutingActivation>RoutingActivation". <RoutingActivation> is the ShortName of the DoIPRoutingActiviation container., Relationship: Contains DoIPRoutingActivationConfirmationFunc, DoIPRoutingActivationConfirmationReqLength, and DoIPRoutingActivationConfirmationResLength., EvidenceClassification: Explicit, SourceReference: 10.2.25 DoIPRoutingActivationConfirmationCallback; PDF page 123 (printed page 123)]
    labels=l-4=DoIPRoutingActivationConfirmationFunc, annotation-text=[Source: AUTOSAR_SWS_DiagnosticOverIP.pdf, ECUCItemID: ECUC_DoIP_00036, ParentContainer: DoIPRoutingActivationConfirmationCallback, Type: EcucFunctionNameDef, RangeOrReferenceTarget: Not specified in source, Multiplicity: 0..1, DefaultValue: Regular Expression, PostBuildVariant: false, Description: Direct C Callback function to trigger the confirmation function for routing activation. If the DoIPRoutingActivationConfirmationFunc parameter is present the DoIP module will not use an RPort of ServiceInterface <RoutingActivation>_RoutingActivation but call the configured function., Relationship: Not specified in source, EvidenceClassification: Explicit, SourceReference: 10.2.25 DoIPRoutingActivationConfirmationCallback; PDF page 123 (printed page 123)]
    labels=l-4=DoIPRoutingActivationConfirmationReqLength, annotation-text=[Source: AUTOSAR_SWS_DiagnosticOverIP.pdf, ECUCItemID: ECUC_DoIP_00037, ParentContainer: DoIPRoutingActivationConfirmationCallback, Type: EcucIntegerParamDef, RangeOrReferenceTarget: 0 .. 4, Multiplicity: 1, DefaultValue: Post-Build Variant false, PostBuildVariant: false, Description: Describes the amount of bytes used to handle to the confirmation function on routing activation. If 0 is configured as length the parameter ConfirmedReqData will not be handled to the API., Relationship: Not specified in source, EvidenceClassification: Explicit, SourceReference: 10.2.25 DoIPRoutingActivationConfirmationCallback; PDF page 123 (printed page 123)]
    labels=l-4=DoIPRoutingActivationConfirmationResLength, annotation-text=[Source: AUTOSAR_SWS_DiagnosticOverIP.pdf, ECUCItemID: ECUC_DoIP_00038, ParentContainer: DoIPRoutingActivationConfirmationCallback, Type: EcucIntegerParamDef, RangeOrReferenceTarget: 0 .. 4, Multiplicity: 1, DefaultValue: Post-Build Variant false, PostBuildVariant: false, Description: Describes the amount of bytes used to read by the confirmation function on routing activation. If 0 is configured as length the parameter ConfirmedResData will not be fetched via the API., Relationship: Not specified in source, EvidenceClassification: Explicit, SourceReference: 10.2.25 DoIPRoutingActivationConfirmationCallback; PDF page 124 (printed page 124)]
    labels=l-4=DoIPTester, annotation-text=[Source: AUTOSAR_SWS_DiagnosticOverIP.pdf, ECUCItemID: ECUC_DoIP_00031, ParentContainer: DoIPInterface, Type: EcucParamConfContainerDef, RangeOrReferenceTarget: Not specified in source, Multiplicity: 1..255, DefaultValue: Not specified in source, PostBuildVariant: false, Description: This container describes the properties of the possible connectable Tester for the DoIP entity., Relationship: Contains DoIPNumByteDiagAckNack and DoIPTesterSA parameters. Defines DoIPRoutingActivationRef to reference DoIPRoutingActivation containers., EvidenceClassification: Explicit, SourceReference: 10.2.26 DoIPTester; PDF page 125 (printed page 125)]
    labels=l-4=DoIPNumByteDiagAckNack, annotation-text=[Source: AUTOSAR_SWS_DiagnosticOverIP.pdf, ECUCItemID: ECUC_DoIP_00042, ParentContainer: DoIPTester, Type: EcucIntegerParamDef, RangeOrReferenceTarget: 0 .. 4294967295, Multiplicity: 1, DefaultValue: Post-Build Variant true, PostBuildVariant: true, Description: Specifies the number of original Diagnostic request bytes the DoIP entity responses on a NACK of a diagnostic response message to the Tester., Relationship: Not specified in source, EvidenceClassification: Explicit, SourceReference: 10.2.26 DoIPTester; PDF page 124 (printed page 124)]
    labels=l-4=DoIPTesterSA, annotation-text=[Source: AUTOSAR_SWS_DiagnosticOverIP.pdf, ECUCItemID: ECUC_DoIP_00043, ParentContainer: DoIPTester, Type: EcucIntegerParamDef, RangeOrReferenceTarget: 0 .. 65535, Multiplicity: 1, DefaultValue: Post-Build Variant true, PostBuildVariant: true, Description: Source Address of the Tester sent via routing activation or diagnostic message., Relationship: Not specified in source, EvidenceClassification: Explicit, SourceReference: 10.2.26 DoIPTester; PDF page 125 (printed page 125)]
    labels=l-4=DoIPRoutingActivationRef, annotation-text=[Source: AUTOSAR_SWS_DiagnosticOverIP.pdf, ECUCItemID: ECUC_DoIP_00062, ParentContainer: DoIPTester, Type: Reference to DoIPRoutingActivation, RangeOrReferenceTarget: Not specified in source, Multiplicity: 1..255, DefaultValue: Not specified in source, PostBuildVariant: true, Description: Reference to a DoIPRoutingActivation describing the possible routing activations of the DoIPTester, Relationship: Not specified in source, EvidenceClassification: Explicit, SourceReference: 10.2.26 DoIPTester; PDF page 126 (printed page 126)]
