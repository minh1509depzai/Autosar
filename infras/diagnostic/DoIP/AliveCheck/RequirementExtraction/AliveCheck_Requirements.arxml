AUTOSAR XML (schema 4.0)
package /DoIP_AliveCheck_Requirements
  annotation SWS_DoIP_00139: labels=[AUTOSAR_SWS_DiagnosticOverIP.pdf, 7.3.2.4.1 Alive check request (payload type 0x0007), PDF page 39; printed page 39, AUTOSAR CP R21-11; Document ID 418], annotation-text=[RequirementText: If the DoIP module needs to send a alive check request, it shall have no payload data but only the generic DoIP header and the payload type set 0x0007., Module: DoIP, Constraints: No payload data; generic DoIP header; payload type 0x0007., RelatedConfiguration: Not specified in source, EvidenceClassification: Explicit, SourceReference: 7.3.2.4.1 Alive check request (payload type 0x0007); PDF page 39; printed page 39; AUTOSAR_SWS_DiagnosticOverIP.pdf, Traceability: SRS_Eth_00083]
  annotation SWS_DoIP_00140: labels=[AUTOSAR_SWS_DiagnosticOverIP.pdf, 7.3.2.4.1 Alive check request (payload type 0x0007), PDF page 39; printed page 39, AUTOSAR CP R21-11; Document ID 418], annotation-text=[RequirementText: After sending an alive check request the DoIP module shall wait the configured time DoIPAliveCheckResponseTimeout to receive a valid alive check response and [SWS_DoIP_00141]. If it does not receive an alive check response, the socket connection on which the alive check request was sent shall be reset as described in [SWS_DoIP_00358]., Module: DoIP, Constraints: Wait for DoIPAliveCheckResponseTimeout; if no alive check response is received, reset the socket as specified by SWS_DoIP_00358., RelatedConfiguration: DoIPAliveCheckResponseTimeout; SWS_DoIP_00141; SWS_DoIP_00358, EvidenceClassification: Explicit, SourceReference: 7.3.2.4.1 Alive check request (payload type 0x0007); PDF page 39; printed page 39; AUTOSAR_SWS_DiagnosticOverIP.pdf, Traceability: SRS_Eth_00083]
  annotation SWS_DoIP_00141: labels=[AUTOSAR_SWS_DiagnosticOverIP.pdf, 7.3.2.4.2 Alive check response (payload type 0x0008), PDF page 40; printed page 40, AUTOSAR CP R21-11; Document ID 418], annotation-text=[RequirementText: If the received Alive check response field "SourceAddress" matches the registered Source Address of the socket connection the response was received on, the DoIP module shall do nothing. Otherwise it shall reset the socket connection as described in [SWS_DoIP_00358]., Module: DoIP, Constraints: Compare response SourceAddress with the registered Source Address of the receiving socket; reset on mismatch., RelatedConfiguration: SWS_DoIP_00358, EvidenceClassification: Explicit, SourceReference: 7.3.2.4.2 Alive check response (payload type 0x0008); PDF page 40; printed page 40; AUTOSAR_SWS_DiagnosticOverIP.pdf, Traceability: SRS_Eth_00083]
