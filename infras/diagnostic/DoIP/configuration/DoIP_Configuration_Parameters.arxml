AUTOSAR XML (schema 00050)
package /DoIP_RoutingActivation_Extract
  elements:
    labels=l-4=DocumentMetadata, annotation-text=[Source: AUTOSAR_SWS_DiagnosticOverIP.pdf, Release: AUTOSAR Classic Platform R21-11, DocumentID: 418, Scope: Routing Activation configuration and supporting configuration explicitly used by its processing flow, Caveat: Traceable knowledge extract in an AUTOSAR-style XML envelope; not validated against the AUTOSAR ECUC schema and not intended for direct ECU configuration-tool import.]
    labels=l-4=DoIPRoutingActivationNumber, annotation-text=[ParameterName: DoIPRoutingActivationNumber, ECUCItemID: ECUC_DoIP_00033, ParentContainer: DoIPRoutingActivation, Type: EcucIntegerParamDef, RangeOrReferenceTarget: 0..255, Multiplicity: 1, DefaultValue: Not specified, PostBuildVariant: true, Description: Identifies the Routing Activation Number expected in a Routing Activation request., RoutingActivationRelationship: Matched against request Activation Type under SWS_DoIP_00108., SourceReference: 10.2.23, PDF p. 119; 7.3.2.3.1, PDF p. 37]
    labels=l-4=DoIPTargetAddressRef, annotation-text=[ParameterName: DoIPTargetAddressRef, ECUCItemID: ECUC_DoIP_00034, ParentContainer: DoIPRoutingActivation, Type: Reference to DoIPTargetAddress, RangeOrReferenceTarget: Target: DoIPTargetAddress, Multiplicity: 1..65535, DefaultValue: Not specified, PostBuildVariant: true, Description: Reference to all DoIPTargetAddress entries activated by this Routing Activation., RoutingActivationRelationship: Successful activation enables routing to configured target addresses under SWS_DoIP_00113., SourceReference: 10.2.23, PDF p. 120; 7.3.2.3.1, PDF p. 38]
    labels=l-4=DoIPRoutingActivationSecurityRequired, annotation-text=[ParameterName: DoIPRoutingActivationSecurityRequired, ECUCItemID: ECUC_DoIP_00096, ParentContainer: DoIPRoutingActivation, Type: EcucBooleanParamDef, RangeOrReferenceTarget: Boolean, Multiplicity: 0..1, DefaultValue: false, PostBuildVariant: Not stated in extracted table, Description: Indicates whether this Routing Activation requires a secure TCP connection., RoutingActivationRelationship: Evaluated with the TCP connection security setting under SWS_DoIP_00294/00295., SourceReference: 10.2.23, PDF p. 120; 7.2, PDF p. 27]
    labels=l-4=DoIPRoutingActivationAuthenticationFunc, annotation-text=[ParameterName: DoIPRoutingActivationAuthenticationFunc, ECUCItemID: ECUC_DoIP_00037, ParentContainer: DoIPRoutingActivationAuthenticationCallback, Type: EcucFunctionNameDef, RangeOrReferenceTarget: Function name, Multiplicity: 0..1, DefaultValue: Not specified, PostBuildVariant: Not specified, Description: Function name for the Routing Activation authentication callback., RoutingActivationRelationship: If omitted while the callback container is configured, the spec describes use of an RPort of service interface <RoutingActivation>_RoutingActivation named CB<RoutingActivation>RoutingActivation. See SWS_DoIP_00109–00111 and API SWS_DoIP_00049., SourceReference: 10.2.24, PDF pp. 120–121; 8.6.3.3, PDF p. 73]
    labels=l-4=DoIPRoutingActivationAuthenticationReqLength, annotation-text=[ParameterName: DoIPRoutingActivationAuthenticationReqLength, ECUCItemID: ECUC_DoIP_00040, ParentContainer: DoIPRoutingActivationAuthenticationCallback, Type: EcucIntegerParamDef, RangeOrReferenceTarget: 0..4 bytes, Multiplicity: 1, DefaultValue: Not specified, PostBuildVariant: false, Description: Number of OEM-specific request bytes used by authentication., RoutingActivationRelationship: If non-zero, the configured request bytes are supplied to the authentication callback., SourceReference: 10.2.24, PDF p. 121; 8.6.3.3, PDF p. 73]
    labels=l-4=DoIPRoutingActivationAuthenticationResLength, annotation-text=[ParameterName: DoIPRoutingActivationAuthenticationResLength, ECUCItemID: ECUC_DoIP_00041, ParentContainer: DoIPRoutingActivationAuthenticationCallback, Type: EcucIntegerParamDef, RangeOrReferenceTarget: 0..4 bytes, Multiplicity: 1, DefaultValue: Not specified, PostBuildVariant: false, Description: Number of bytes used for authentication response data; if zero, AuthenticationResData is not fetched via the API., RoutingActivationRelationship: If non-zero, authentication response bytes are included in the Routing Activation Response OEM-specific field under SWS_DoIP_00120., SourceReference: 10.2.24, PDF p. 121; 7.3.2.3.1–7.3.2.3.2, PDF pp. 37–39]
    labels=l-4=DoIPRoutingActivationConfirmationFunc, annotation-text=[ParameterName: DoIPRoutingActivationConfirmationFunc, ECUCItemID: ECUC_DoIP_00064, ParentContainer: DoIPRoutingActivationConfirmationCallback, Type: EcucFunctionNameDef, RangeOrReferenceTarget: Function name, Multiplicity: 0..1, DefaultValue: Not specified, PostBuildVariant: Not specified, Description: Function name for the Routing Activation confirmation callback., RoutingActivationRelationship: If omitted while the callback container is configured, the spec describes use of an RPort of service interface <RoutingActivation>_RoutingActivation named CB<RoutingActivation>RoutingActivation. See SWS_DoIP_00112, SWS_DoIP_00114 and SWS_DoIP_00274., SourceReference: 10.2.25, PDF pp. 121–122; 8.6.3.2, PDF p. 72]
    labels=l-4=DoIPRoutingActivationConfirmationReqLength, annotation-text=[ParameterName: DoIPRoutingActivationConfirmationReqLength, ECUCItemID: ECUC_DoIP_00065, ParentContainer: DoIPRoutingActivationConfirmationCallback, Type: EcucIntegerParamDef, RangeOrReferenceTarget: 0..4 bytes, Multiplicity: 1, DefaultValue: Not specified, PostBuildVariant: false, Description: Number of OEM-specific request bytes supplied to the confirmation function., RoutingActivationRelationship: If non-zero, the callback handles the configured trailing bytes of the OEM-specific request field., SourceReference: 10.2.25, PDF p. 122; 8.6.3.2, PDF p. 72]
    labels=l-4=DoIPRoutingActivationConfirmationResLength, annotation-text=[ParameterName: DoIPRoutingActivationConfirmationResLength, ECUCItemID: ECUC_DoIP_00066, ParentContainer: DoIPRoutingActivationConfirmationCallback, Type: EcucIntegerParamDef, RangeOrReferenceTarget: 0..4 bytes, Multiplicity: 1, DefaultValue: Not specified, PostBuildVariant: false, Description: Number of OEM-specific response bytes returned by the confirmation function., RoutingActivationRelationship: If non-zero and confirmation returns E_OK, response bytes are attached to the OEM-specific field under SWS_DoIP_00112/SWS_DoIP_00120., SourceReference: 10.2.25, PDF p. 122; 7.3.2.3.1–7.3.2.3.2, PDF pp. 38–39]
    labels=l-4=DoIPTesterSA, annotation-text=[ParameterName: DoIPTesterSA, ECUCItemID: ECUC_DoIP_00043, ParentContainer: DoIPTester, Type: EcucIntegerParamDef, RangeOrReferenceTarget: 0..65535 (16-bit logical address), Multiplicity: 1, DefaultValue: Not specified, PostBuildVariant: true, Description: Source Address of the tester sent via Routing Activation or diagnostic message., RoutingActivationRelationship: Request Source Address is matched against configured DoIPTesterSA under SWS_DoIP_00102; echoed as Logical Address Tester under SWS_DoIP_00116., SourceReference: 10.2.26, PDF p. 125; 7.3.2.3.1–7.3.2.3.2, PDF pp. 36 and 39]
    labels=l-4=DoIPRoutingActivationRef, annotation-text=[ParameterName: DoIPRoutingActivationRef, ECUCItemID: ECUC_DoIP_00062, ParentContainer: DoIPTester, Type: Reference to DoIPRoutingActivation, RangeOrReferenceTarget: Target: DoIPRoutingActivation, Multiplicity: 1..255, DefaultValue: Not specified, PostBuildVariant: true, Description: References possible Routing Activations for this tester., RoutingActivationRelationship: Activation Type is matched against DoIPRoutingActivationNumber in one of the referenced activations under SWS_DoIP_00108., SourceReference: 10.2.26, PDF p. 125; 7.3.2.3.1, PDF p. 37]
    labels=l-4=DoIPMaxTesterConnections, annotation-text=[ParameterName: DoIPMaxTesterConnections, ECUCItemID: Not verified in extracted parameter table, ParentContainer: DoIPGeneral (parent to verify), Type: Not verified, RangeOrReferenceTarget: Not verified, Multiplicity: Not verified, DefaultValue: Not verified, PostBuildVariant: Not verified, Description: Maximum registered tester connections considered during Routing Activation., RoutingActivationRelationship: SWS_DoIP_00107 compares registered connections against this parameter. Exact ECUC item ID, range, default, and type need verification in the full configuration table., SourceReference: 7.3.2.3.1, PDF p. 36; configuration table not verified in this extraction]
    labels=l-4=DoIPAliveCheckResponseTimeout, annotation-text=[ParameterName: DoIPAliveCheckResponseTimeout, ECUCItemID: Not verified in extracted parameter table, ParentContainer: Parent container to verify, Type: Not verified, RangeOrReferenceTarget: Not verified, Multiplicity: Not verified, DefaultValue: Not verified, PostBuildVariant: Not verified, Description: Configured wait time for an Alive Check response., RoutingActivationRelationship: Used by SWS_DoIP_00105 and SWS_DoIP_00140. Exact unit, range, default, and ECUC item ID need verification in the full configuration table., SourceReference: 7.3.2.3.1, PDF p. 36; 7.3.2.4.1, PDF p. 39; configuration table not verified]
    labels=l-4=DoIPTcpConnectionSecurityRequired, annotation-text=[ParameterName: DoIPTcpConnectionSecurityRequired, ECUCItemID: Not verified in extracted parameter table, ParentContainer: DoIPTcpConnection, Type: EcucBooleanParamDef, RangeOrReferenceTarget: Boolean, Multiplicity: 1, DefaultValue: false (if not set), PostBuildVariant: Not verified, Description: Indicates whether the TCP connection is configured to require a secure connection., RoutingActivationRelationship: Evaluated together with DoIPRoutingActivationSecurityRequired under SWS_DoIP_00294/00295., SourceReference: 10.2.15, PDF p. 113; 7.2, PDF p. 27; ECUC item ID/table details not verified]
    labels=l-4=DoIPLogicalAddress, annotation-text=[ParameterName: DoIPLogicalAddress, ECUCItemID: Not verified in extracted parameter table, ParentContainer: DoIP, Type: Not verified, RangeOrReferenceTarget: Not verified, Multiplicity: Not verified, DefaultValue: Not verified, PostBuildVariant: Not verified, Description: Configured logical address of the DoIP entity., RoutingActivationRelationship: Used as Logical Address DoIP entity in Routing Activation Response under SWS_DoIP_00118. Exact configuration-table details not included in this extract., SourceReference: 7.3.2.3.2, PDF p. 39; configuration table not verified]
    labels=l-4=DoIPMaxRequestBytes, annotation-text=[ParameterName: DoIPMaxRequestBytes, ECUCItemID: ECUC_DoIP_00019, ParentContainer: DoIPGeneral, Type: EcucIntegerParamDef, RangeOrReferenceTarget: 1 .. 4294967295, Multiplicity: 1, DefaultValue: Not specified in the source table, PostBuildVariant: false, ValueConfigurationClass: Pre-compile time, Description: Specifies the maximum allowed bytes of a DoIP message request without the DoIP header., SectionRelationship: Under SWS_DoIP_00017, if a received message payload length exceeds this configured value, the DoIP module sends NACK 0x02 and discards the message., SourceReference: 10.2.3, PDF p. 89; 7.3.2.1, PDF p. 30; SWS_DoIP_00017, ExtractionNote: Supporting DoIPGeneral parameter referenced by the Generic acknowledge section; it is not a child of DoIPRoutingActivation.]
