AUTOSAR XML (schema 4.0)
package /Requirements_Extract
  11 x annotation:
    SWS_DoIP_00090: labels=[AUTOSAR_SWS_DiagnosticOverIP.pdf, 7.3.2.5 Diagnostic power mode information request (payload type 0x4003), PDF page 40; printed page 40], annotation-text=[RequirementText: When the module receives a DoIP message with payload Type 0x4003 on a connection different than a configured DoIPUdpConnection, the module shall discard the DoIP message., Module: DoIP (Diagnostic over IP), Constraints: As stated in the requirement text; see associated payload type and connection restrictions., RelatedConfiguration: DoIPUdpConnection, EvidenceClassification: Explicit, SourceReference: AUTOSAR_SWS_DiagnosticOverIP.pdf, section 7.3.2.5, Diagnostic power mode information request (payload type 0x4003); PDF page 40; printed page 40.]
    SWS_DoIP_00091: labels=[AUTOSAR_SWS_DiagnosticOverIP.pdf, 7.3.2.5 Diagnostic power mode information request (payload type 0x4003), PDF page 40; printed page 40], annotation-text=[RequirementText: The expected payload length (see [SWS_DoIP_00019]) for diagnostic power mode information request message with payload type 0x4003 shall be exactly 0., Module: DoIP (Diagnostic over IP), Constraints: As stated in the requirement text; see associated payload type and connection restrictions., RelatedConfiguration: None explicitly stated, EvidenceClassification: Explicit, SourceReference: AUTOSAR_SWS_DiagnosticOverIP.pdf, section 7.3.2.5, Diagnostic power mode information request (payload type 0x4003); PDF page 40; printed page 40.]
    SWS_DoIP_00092: labels=[AUTOSAR_SWS_DiagnosticOverIP.pdf, 7.3.2.5 Diagnostic power mode information request (payload type 0x4003), PDF page 40; printed page 40], annotation-text=[RequirementText: After a valid Diagnostic power mode request message, the DoIP module shall send a Diagnostic Power mode information response message ([SWS_DoIP_00093]) on the configured DoIPUdpConnection., Module: DoIP (Diagnostic over IP), Constraints: As stated in the requirement text; see associated payload type and connection restrictions., RelatedConfiguration: DoIPUdpConnection, EvidenceClassification: Explicit, SourceReference: AUTOSAR_SWS_DiagnosticOverIP.pdf, section 7.3.2.5, Diagnostic power mode information request (payload type 0x4003); PDF page 40; printed page 40.]
    SWS_DoIP_00093: labels=[AUTOSAR_SWS_DiagnosticOverIP.pdf, 7.3.2.5 Diagnostic power mode information response (payload type 0x4004), PDF page 40–41; printed page 40–41], annotation-text=[RequirementText: The "Diagnostic Power Mode" byte of diagnostic power mode information response message contains the 1 Byte value retrieved by a call to the configured DoIPPowerModeCallback (for the signature see <User>DoIPGetPowerModeStatus, [SWS_DoIP_00047]). If the function returns E_OK, the "Diagnostic Power Mode" shall be set to the retrieved value of PowerStateReady, otherwise it shall be set to 0x00 to indicate that the power mode is not ready., Module: DoIP (Diagnostic over IP), Constraints: As stated in the requirement text; see associated payload type and connection restrictions., RelatedConfiguration: DoIPPowerModeCallback, EvidenceClassification: Explicit, SourceReference: AUTOSAR_SWS_DiagnosticOverIP.pdf, section 7.3.2.5, Diagnostic power mode information response (payload type 0x4004); PDF page 40–41; printed page 40–41.]
    SWS_DoIP_00094: labels=[AUTOSAR_SWS_DiagnosticOverIP.pdf, 7.3.2.5 Diagnostic entity status request (payload type 0x4001), PDF page 41; printed page 41], annotation-text=[RequirementText: When the module receives a DoIP message with payload Type 0x4001 on a connection different than a configured DoIPUdpConnection, the module shall discard the DoIP message., Module: DoIP (Diagnostic over IP), Constraints: As stated in the requirement text; see associated payload type and connection restrictions., RelatedConfiguration: DoIPUdpConnection, EvidenceClassification: Explicit, SourceReference: AUTOSAR_SWS_DiagnosticOverIP.pdf, section 7.3.2.5, Diagnostic entity status request (payload type 0x4001); PDF page 41; printed page 41.]
    SWS_DoIP_00095: labels=[AUTOSAR_SWS_DiagnosticOverIP.pdf, 7.3.2.5 Diagnostic entity status request (payload type 0x4001), PDF page 41; printed page 41], annotation-text=[RequirementText: The expected payload length (see [SWS_DoIP_00019]) for diagnostic entity status request message with payload type 0x4001 shall be exactly 0., Module: DoIP (Diagnostic over IP), Constraints: As stated in the requirement text; see associated payload type and connection restrictions., RelatedConfiguration: None explicitly stated, EvidenceClassification: Explicit, SourceReference: AUTOSAR_SWS_DiagnosticOverIP.pdf, section 7.3.2.5, Diagnostic entity status request (payload type 0x4001); PDF page 41; printed page 41.]
    SWS_DoIP_00096: labels=[AUTOSAR_SWS_DiagnosticOverIP.pdf, 7.3.2.5 Diagnostic entity status request (payload type 0x4001), PDF page 41; printed page 41], annotation-text=[RequirementText: After a valid Diagnostic entity status request message, the DoIP module shall send a Diagnostic entity status response message (see Table 7.11) on the configured DoIPUdpConnection., Module: DoIP (Diagnostic over IP), Constraints: As stated in the requirement text; see associated payload type and connection restrictions., RelatedConfiguration: DoIPUdpConnection, EvidenceClassification: Explicit, SourceReference: AUTOSAR_SWS_DiagnosticOverIP.pdf, section 7.3.2.5, Diagnostic entity status request (payload type 0x4001); PDF page 41; printed page 41.]
    SWS_DoIP_00097: labels=[AUTOSAR_SWS_DiagnosticOverIP.pdf, 7.3.2.5 Diagnostic entity status response (payload type 0x4002), PDF page 41; printed page 41], annotation-text=[RequirementText: The "Node Type" byte of a diagnostic entity status response message shall contain the configured DoIPNodeType, whereas DOIP_GATEWAY shall be represented by 0x00 and DOIP_NODE shall be represented by 0x01., Module: DoIP (Diagnostic over IP), Constraints: As stated in the requirement text; see associated payload type and connection restrictions., RelatedConfiguration: DoIPNodeType, EvidenceClassification: Explicit, SourceReference: AUTOSAR_SWS_DiagnosticOverIP.pdf, section 7.3.2.5, Diagnostic entity status response (payload type 0x4002); PDF page 41; printed page 41.]
    SWS_DoIP_00098: labels=[AUTOSAR_SWS_DiagnosticOverIP.pdf, 7.3.2.5 Diagnostic entity status response (payload type 0x4002), PDF page 41; printed page 41], annotation-text=[RequirementText: The "Max open sockets" byte of a diagnostic entity status response message shall contain the configured DoIPMaxTesterConnections. This parameter represents the maximum number of concurrent TCP_DATA sockets allowed with this DoIP entity, excluding the reserve socket required for socket handling as defined in the ISO 13400-2 standard., Module: DoIP (Diagnostic over IP), Constraints: As stated in the requirement text; see associated payload type and connection restrictions., RelatedConfiguration: DoIPMaxTesterConnections, EvidenceClassification: Explicit, SourceReference: AUTOSAR_SWS_DiagnosticOverIP.pdf, section 7.3.2.5, Diagnostic entity status response (payload type 0x4002); PDF page 41; printed page 41.]
    SWS_DoIP_00099: labels=[AUTOSAR_SWS_DiagnosticOverIP.pdf, 7.3.2.5 Diagnostic entity status response (payload type 0x4002), PDF page 42; printed page 42], annotation-text=[RequirementText: The "Currently open sockets" byte of a diagnostic entity status response message shall contain the currently active connections, based on the information described in [SWS_DoIP_00002]., Module: DoIP (Diagnostic over IP), Constraints: As stated in the requirement text; see associated payload type and connection restrictions., RelatedConfiguration: None explicitly stated; references [SWS_DoIP_00002], EvidenceClassification: Explicit, SourceReference: AUTOSAR_SWS_DiagnosticOverIP.pdf, section 7.3.2.5, Diagnostic entity status response (payload type 0x4002); PDF page 42; printed page 42.]
    SWS_DoIP_00100: labels=[AUTOSAR_SWS_DiagnosticOverIP.pdf, 7.3.2.5 Diagnostic entity status response (payload type 0x4002), PDF page 42; printed page 42], annotation-text=[RequirementText: The "Max data size" bytes are only supported if the configuration parameter DoIPEntityStatusMaxByteFieldUse is set to TRUE. In this case, the diagnostic entity status response message shall contain the configured DoIPMaxRequestBytes in the "Max data size" field., Module: DoIP (Diagnostic over IP), Constraints: As stated in the requirement text; see associated payload type and connection restrictions., RelatedConfiguration: DoIPEntityStatusMaxByteFieldUse; DoIPMaxRequestBytes, EvidenceClassification: Explicit, SourceReference: AUTOSAR_SWS_DiagnosticOverIP.pdf, section 7.3.2.5, Diagnostic entity status response (payload type 0x4002); PDF page 42; printed page 42.]
