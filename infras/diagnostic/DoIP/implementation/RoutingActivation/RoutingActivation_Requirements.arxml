AUTOSAR XML (schema 4-3-0)
package /DoIP_RoutingActivation_Extract
  22 x annotation:
    SWS_DoIP_00101: labels=[AUTOSAR_SWS_DiagnosticOverIP.pdf, 7.3.2.3 Routing activation, PDF page 36; printed page 35], annotation-text=[Requirement ID: SWS_DoIP_00101, Description: Discard a Routing Activation Request (payload type 0x0005) received on a connection that is not configured as DoIPTcpConnection., Conditions: Message payload type is 0x0005 and receiving connection is not a configured DoIPTcpConnection., Expected behavior: Discard the DoIP message., Notes: The specification notes this payload is also not allowed on UDP.]
    SWS_DoIP_00117: labels=[AUTOSAR_SWS_DiagnosticOverIP.pdf, 7.3.2.3 Routing activation, PDF page 36; printed page 35], annotation-text=[Requirement ID: SWS_DoIP_00117, Description: The expected payload length for a Routing Activation Request (payload type 0x0005) shall be exactly 7 or 11 bytes., Conditions: Payload type 0x0005., Expected behavior: Accept the specified expected lengths of 7 or 11 bytes.]
    SWS_DoIP_00102: labels=[AUTOSAR_SWS_DiagnosticOverIP.pdf, 7.3.2.3 Routing activation, PDF page 36; printed page 35], annotation-text=[Requirement ID: SWS_DoIP_00102, Description: Continue Routing Activation Request processing as defined by SWS_DoIP_00103 when the DoIP header is valid and Source Address matches a configured DoIPTesterSA., Conditions: Valid DoIP header; Source Address matches configured DoIPTesterSA., Expected behavior: Continue with SWS_DoIP_00103.]
    SWS_DoIP_00106: labels=[AUTOSAR_SWS_DiagnosticOverIP.pdf, 7.3.2.3 Routing activation, PDF page 36; printed page 35], annotation-text=[Requirement ID: SWS_DoIP_00106, Description: If the Source Address is valid but the receiving connection is already registered to another source address, send a Routing Activation Response on the same connection with response code 0x02 and close the socket connection., Conditions: Valid Source Address; receiving connection is registered to a different source address., Expected behavior: Send response code 0x02 on the same connection, then close the socket per SWS_DoIP_00058.]
    SWS_DoIP_00104: labels=[AUTOSAR_SWS_DiagnosticOverIP.pdf, 7.3.2.3 Routing activation, PDF page 36; printed page 35], annotation-text=[Requirement ID: SWS_DoIP_00104, Description: If Source Address does not match a configured DoIPTesterSA, send a Routing Activation Response on the same connection with response code 0x00 and close the socket connection., Conditions: Source Address is not configured as DoIPTesterSA., Expected behavior: Send response code 0x00 on the same connection, then close the socket per SWS_DoIP_00058.]
    SWS_DoIP_00103: labels=[AUTOSAR_SWS_DiagnosticOverIP.pdf, 7.3.2.3 Routing activation, PDF page 36; printed page 35], annotation-text=[Requirement ID: SWS_DoIP_00103, Description: Continue processing as defined by SWS_DoIP_00105 when the received Source Address is already registered to this same socket connection, or is not yet registered to any connection., Conditions: Source Address is registered to the same socket, or is not registered to a connection., Expected behavior: Continue with SWS_DoIP_00105.]
    SWS_DoIP_00105: labels=[AUTOSAR_SWS_DiagnosticOverIP.pdf, 7.3.2.3 Routing activation, PDF page 36; printed page 35], annotation-text=[Requirement ID: SWS_DoIP_00105, Description: If Source Address is registered to another connection on the same DoIPInterface, trigger an Alive Check on that connection and wait for its response or DoIPAliveCheckResponseTimeout., Conditions: Source Address is registered to another connection on the same DoIPInterface., Expected behavior: If Alive Check response arrives in time, send response code 0x03 and close the current socket. If the source is not registered, or the Alive Check times out, continue with SWS_DoIP_00107., Notes: Alive Check behavior references SWS_DoIP_00139 and SWS_DoIP_00140.]
    SWS_DoIP_00107: labels=[AUTOSAR_SWS_DiagnosticOverIP.pdf, 7.3.2.3 Routing activation, PDF page 37; printed page 36], annotation-text=[Requirement ID: SWS_DoIP_00107, Description: Check the number of registered connections against DoIPMaxTesterConnections., Conditions: Routing activation has reached this check., Expected behavior: If registered connections are fewer than DoIPMaxTesterConnections, continue with SWS_DoIP_00108. Otherwise send Alive Check requests to all registered connections. If all respond before timeout, send response code 0x01 and close the current socket. If at least one times out, close the current socket and continue with SWS_DoIP_00108., Notes: Alive Check references SWS_DoIP_00139 and SWS_DoIP_00140.]
    SWS_DoIP_00108: labels=[AUTOSAR_SWS_DiagnosticOverIP.pdf, 7.3.2.3 Routing activation, PDF page 37; printed page 36], annotation-text=[Requirement ID: SWS_DoIP_00108, Description: Check whether Activation Type matches a DoIPRoutingActivationNumber referenced by the configured DoIPTesterSA., Conditions: Activation Type bytes are compared with configured DoIPRoutingActivationNumber values for the tester., Expected behavior: If a match exists, continue with SWS_DoIP_00109.]
    SWS_DoIP_00160: labels=[AUTOSAR_SWS_DiagnosticOverIP.pdf, 7.3.2.3 Routing activation, PDF page 37; printed page 36], annotation-text=[Requirement ID: SWS_DoIP_00160, Description: If Activation Type does not satisfy SWS_DoIP_00108, send Routing Activation Response code 0x06 and close the socket connection., Conditions: Activation Type does not match a configured routing activation number., Expected behavior: Send response code 0x06 and close the socket per SWS_DoIP_00058.]
    SWS_DoIP_00109: labels=[AUTOSAR_SWS_DiagnosticOverIP.pdf, 7.3.2.3 Routing activation, PDF page 37; printed page 36], annotation-text=[Requirement ID: SWS_DoIP_00109, Description: If a DoIPRoutingActivationAuthenticationCallback is configured for the referenced routing activation, call it., Conditions: Authentication callback configured for the referenced DoIPRoutingActivation., Expected behavior: If DoIPRoutingActivationAuthenticationReqLength is nonzero, additionally process the first configured number of bytes of the optional OEM specific field., Notes: Callback signature is described by SWS_DoIP_00049.]
    SWS_DoIP_00161: labels=[AUTOSAR_SWS_DiagnosticOverIP.pdf, 7.3.2.3 Routing activation, PDF page 37; printed page 36], annotation-text=[Requirement ID: SWS_DoIP_00161, Description: If the authentication callback returns E_OK, consider authentication successful., Conditions: DoIPRoutingActivationAuthenticationCallback returns E_OK., Expected behavior: If DoIPRoutingActivationAuthenticationResLength is nonzero, attach the configured number of initial response bytes to the OEM specific field of the Routing Activation Response.]
    SWS_DoIP_00110: labels=[AUTOSAR_SWS_DiagnosticOverIP.pdf, 7.3.2.3 Routing activation, PDF page 37; printed page 36], annotation-text=[Requirement ID: SWS_DoIP_00110, Description: If the authentication callback returns DOIP_E_PENDING, call it again on the next DoIP_MainFunction cycle until it returns another value., Conditions: Authentication callback returns DOIP_E_PENDING., Expected behavior: Consider the socket connection registered to this DoIPTesterSA without activating routing.]
    SWS_DoIP_00111: labels=[AUTOSAR_SWS_DiagnosticOverIP.pdf, 7.3.2.3 Routing activation, PDF page 37; printed page 36], annotation-text=[Requirement ID: SWS_DoIP_00111, Description: If the authentication callback returns a value other than E_OK or DOIP_E_PENDING (for example E_NOT_OK), send Routing Activation Response code 0x04., Conditions: Authentication callback returns an error/other value., Expected behavior: Send response code 0x04; consider the socket registered to this DoIPTesterSA without activating routing.]
    SWS_DoIP_00112: labels=[AUTOSAR_SWS_DiagnosticOverIP.pdf, 7.3.2.3 Routing activation, PDF page 38; printed page 37], annotation-text=[Requirement ID: SWS_DoIP_00112, Description: If a DoIPRoutingActivationConfirmationCallback is configured for the referenced routing activation, call it., Conditions: Confirmation callback configured for the referenced DoIPRoutingActivation., Expected behavior: If DoIPRoutingActivationConfirmationReqLength is nonzero, process the configured number of trailing bytes of the optional OEM specific field. If callback returns E_OK, confirmation succeeds; if DoIPRoutingActivationConfirmationResLength is nonzero, append the configured number of trailing response bytes to the OEM specific field., Notes: Callback signature is described by SWS_DoIP_00048.]
    SWS_DoIP_00114: labels=[AUTOSAR_SWS_DiagnosticOverIP.pdf, 7.3.2.3 Routing activation, PDF page 38; printed page 37], annotation-text=[Requirement ID: SWS_DoIP_00114, Description: If the confirmation callback returns DOIP_E_PENDING, send one Routing Activation Response with response code 0x11., Conditions: DoIPRoutingActivationConfirmationCallback returns DOIP_E_PENDING., Expected behavior: Send response code 0x11 once.]
    SWS_DoIP_00274: labels=[AUTOSAR_SWS_DiagnosticOverIP.pdf, 7.3.2.3 Routing activation, PDF page 38; printed page 37], annotation-text=[Requirement ID: SWS_DoIP_00274, Description: If the confirmation callback returns E_NOT_OK, send Routing Activation Response code 0x05 and close the socket connection., Conditions: DoIPRoutingActivationConfirmationCallback returns E_NOT_OK., Expected behavior: Send response code 0x05 and close the socket per SWS_DoIP_00058.]
    SWS_DoIP_00113: labels=[AUTOSAR_SWS_DiagnosticOverIP.pdf, 7.3.2.3 Routing activation, PDF page 38; printed page 37], annotation-text=[Requirement ID: SWS_DoIP_00113, Description: If none of the preceding checks has caused a response, consider the routing activation confirmed, authorized, and valid., Conditions: No earlier check sent a Routing Activation Response., Expected behavior: Send response code 0x10; register the socket to the DoIPTesterSA and enable routing for this activation, making routing to configured DoIPTargetAdressRef active for diagnostic requests received on this connection.]
    SWS_DoIP_00116: labels=[AUTOSAR_SWS_DiagnosticOverIP.pdf, 7.3.2.3.2 Routing activation response (payload type 0x0006), PDF page 39; printed page 38], annotation-text=[Requirement ID: SWS_DoIP_00116, Description: Set the Logical Address Tester field to the tester source address from the Routing Activation Request., Conditions: Constructing a Routing Activation Response., Expected behavior: Populate Logical Address Tester with the request's Tester SA.]
    SWS_DoIP_00118: labels=[AUTOSAR_SWS_DiagnosticOverIP.pdf, 7.3.2.3.2 Routing activation response (payload type 0x0006), PDF page 39; printed page 38], annotation-text=[Requirement ID: SWS_DoIP_00118, Description: Set the Logical Address DoIP entity field to the configured DoIPLogicalAddress., Conditions: Constructing a Routing Activation Response., Expected behavior: Populate Logical Address DoIP entity from DoIPLogicalAddress.]
    SWS_DoIP_00119: labels=[AUTOSAR_SWS_DiagnosticOverIP.pdf, 7.3.2.3.2 Routing activation response (payload type 0x0006), PDF page 39; printed page 38], annotation-text=[Requirement ID: SWS_DoIP_00119, Description: Set the Routing Activation Response Code according to the response conditions in the referenced requirements., Conditions: Constructing a Routing Activation Response., Expected behavior: Derive response code according to SWS_DoIP_00106, SWS_DoIP_00104, SWS_DoIP_00105, SWS_DoIP_00107, SWS_DoIP_00160, SWS_DoIP_00111, SWS_DoIP_00114, SWS_DoIP_00274, and SWS_DoIP_00113.]
    SWS_DoIP_00120: labels=[AUTOSAR_SWS_DiagnosticOverIP.pdf, 7.3.2.3.2 Routing activation response (payload type 0x0006), PDF page 39; printed page 38], annotation-text=[Requirement ID: SWS_DoIP_00120, Description: Fill the OEM specific field with optional values defined in chapter 7.3.2.2.1 when the corresponding response lengths are used., Conditions: DoIPRoutingActivationAuthenticationResLength and/or DoIPRoutingActivationConfirmationResLength is used., Expected behavior: Populate the OEM specific response field with the configured optional callback response data.]
